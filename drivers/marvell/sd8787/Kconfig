## drivers/marvell/sd8787/Kconfig
```kconfig
menuconfig MRVL_SD8XXX
	tristate "Marvell sd8XXX Driver"
	default n

config MRVL_SD8XXX_WIFI
	tristate "Marvell sd8XXX_WIFI Driver"
	depends on MRVL_SD8XXX
	default n
	---help---
	  Marvell sd87XX wifi driver.

config MRVL_SD8XXX_BT
	tristate "Marvell sd8XXX_BT Driver"
	depends on MRVL_SD8XXX
	default n
	---help---
	  Marvell sd87XX bt driver.
```

## drivers/marvell/security/Kconfig
```kconfig
menuconfig MARVELL_SECURITY
	tristate "Marvell Security"
	default n

config MARVELL_SECURITY_GEU
	tristate "Marvell pxa-geu Driver"
	depends on MARVELL_SECURITY
	default n
	---help---
	  pxa-geu driver for generic encrypt unit.
```
